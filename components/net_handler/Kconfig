## components/net_handler/Kconfig
```kconfig
menu "Network Configuration"
    
    config ESP_WIFI_SSID
        string "WiFi SSID"
        default "myssid"
        help
            SSID (network name) for the example to connect to.

    config ESP_WIFI_PASSWORD
        string "WiFi Password"
        default "mypassword"
        help
            WiFi password (WPA or WPA2) for the example to use.
            Can be left blank if the network has no security set.
    # endif
endmenu
```

## sdkconfig.defaults
```kconfig
#
# SDK tool configuration
#
CONFIG_SYSTEM_EVENT_TASK_STACK_SIZE=4096
CONFIG_TIMER_TASK_STACK_DEPTH=3072
#Flash
CONFIG_ESPTOOLPY_FLASHSIZE_4MB=y
CONFIG_ESPTOOLPY_FLASHSIZE="4MB"

#partition table
CONFIG_PARTITION_TABLE_TWO_OTA=y
CONFIG_PARTITION_TABLE_CUSTOM_FILENAME="partitions.csv"
CONFIG_PARTITION_TABLE_FILENAME="partitions_two_ota.csv"
CONFIG_PARTITION_TABLE_OFFSET=0x10000
CONFIG_PARTITION_TABLE_MD5=y

#ESP32 TTGO + OLED
#CONFIG_ESP32_XTAL_FREQ_26=y
#CONFIG_ESP32_XTAL_FREQ=26
CONFIG_SSD1306_ENABLE_DEFAULT_I2C_INTERFACE=y
CONFIG_SSD1306_DEFAULT_I2C_PORT_NUMBER=1
CONFIG_SSD1306_DEFAULT_I2C_SCL_PIN=5
CONFIG_SSD1306_DEFAULT_I2C_SDA_PIN=33

CONFIG_ESPFS_IMAGEROOTDIR="html"
```
